## linux/buildroot/external/Config.in
```kconfig
menu "ZYBO Z7 Audio DSP"
    source "$BR2_EXTERNAL_ZYBO_AUDIO_PATH/package/Config.in"
endmenu
```

## linux/buildroot/external/configs/zybo_z7_audio_defconfig
```kconfig
# Buildroot Defconfig — ZYBO Audio DSP (Buildroot 2024.02)
# Architecture: ARM Cortex-A9, Zynq-7000 XC7Z010
BR2_arm=y
BR2_cortex_a9=y
BR2_ARM_ENABLE_NEON=y
BR2_ARM_ENABLE_VFP=y
BR2_ARM_FPU_VFPV3D16=y

# Toolchain: Buildroot internal glibc
BR2_TOOLCHAIN_BUILDROOT_GLIBC=y
BR2_TOOLCHAIN_BUILDROOT_CXX=y
BR2_TOOLCHAIN_BUILDROOT_WCHAR=y

# System
BR2_TARGET_GENERIC_HOSTNAME="zybo-audio"
BR2_TARGET_GENERIC_ISSUE="ZYBO Audio DSP"
BR2_INIT_BUSYBOX=y
BR2_ROOTFS_DEVICE_CREATION_DYNAMIC_DEVTMPFS=y

# Kernel: linux-xlnx 5.15
BR2_LINUX_KERNEL=y
BR2_LINUX_KERNEL_CUSTOM_GIT=y
BR2_LINUX_KERNEL_CUSTOM_REPO_URL="https://github.com/Xilinx/linux-xlnx.git"
BR2_LINUX_KERNEL_CUSTOM_REPO_VERSION="xlnx_rebase_v5.15_LTS"
BR2_LINUX_KERNEL_DEFCONFIG="xilinx_zynq"
BR2_LINUX_KERNEL_CONFIG_FRAGMENT_FILES="$(BR2_EXTERNAL_ZYBO_AUDIO_PATH)/board/zybo-z7/linux.fragment"
BR2_LINUX_KERNEL_UIMAGE=y
BR2_LINUX_KERNEL_UIMAGE_LOADADDR="0x00008000"
BR2_LINUX_KERNEL_DTS_SUPPORT=y

# Boot: U-Boot 2024.01
BR2_TARGET_UBOOT=y
BR2_TARGET_UBOOT_BUILD_SYSTEM_KCONFIG=y
BR2_TARGET_UBOOT_CUSTOM_GIT=y
BR2_TARGET_UBOOT_CUSTOM_REPO_URL="https://source.denx.de/u-boot/u-boot.git"
BR2_TARGET_UBOOT_CUSTOM_REPO_VERSION="v2024.01"
BR2_TARGET_UBOOT_BOARD_DEFCONFIG="zynq_zybo"

# Root filesystem
BR2_TARGET_ROOTFS_EXT2=y
BR2_TARGET_ROOTFS_EXT2_4=y
BR2_TARGET_ROOTFS_EXT2_SIZE="256M"
BR2_TARGET_ROOTFS_TAR=y

# SD card
BR2_PACKAGE_HOST_GENIMAGE=y
BR2_ROOTFS_POST_IMAGE_SCRIPT="$(BR2_EXTERNAL_ZYBO_AUDIO_PATH)/board/zybo-z7/post-build.sh"

# Rootfs overlay
BR2_ROOTFS_OVERLAY="$(BR2_EXTERNAL_ZYBO_AUDIO_PATH)/board/zybo-z7/rootfs_overlay"

# ── Packages ──────────────────────────────────────────────────────────
# ALSA
BR2_PACKAGE_ALSA_LIB=y
BR2_PACKAGE_ALSA_UTILS=y
BR2_PACKAGE_ALSA_UTILS_APLAY=y
BR2_PACKAGE_ALSA_UTILS_AMIXER=y

# Audio decoding
BR2_PACKAGE_LIBSNDFILE=y
BR2_PACKAGE_MPG123=y
BR2_PACKAGE_FLAC=y
BR2_PACKAGE_LIBMAD=y
BR2_PACKAGE_LIBVORBIS=y

# MPD — music player daemon
BR2_PACKAGE_MPD=y
BR2_PACKAGE_MPD_ALSA=y
BR2_PACKAGE_MPD_FLAC=y
BR2_PACKAGE_MPD_MAD=y
BR2_PACKAGE_MPD_VORBIS=y
BR2_PACKAGE_MPD_LIBNFS=y
BR2_PACKAGE_MPD_CURL=y

# Network filesystem
BR2_PACKAGE_CIFS_UTILS=y
BR2_PACKAGE_LIBNFS=y
BR2_PACKAGE_LIBCURL=y

# Streaming
BR2_PACKAGE_SHAIRPORT_SYNC=y

# System
BR2_PACKAGE_OPENSSH=y
BR2_PACKAGE_I2C_TOOLS=y
```

## linux/driver/Kconfig
```kconfig
config SND_SOC_ZYBO_SND_CARD
	tristate "ZYBO Audio ASoC Sound Card"
	depends on SND_SOC && OF
	select SND_SOC_SSM2602
	select SND_DMAENGINE_PCM
	select SND_SOC_GENERIC_DMAENGINE_PCM
	help
	  This option enables the ASoC sound card for the Digilent ZYBO
	  board with the d_axi_i2s_audio IP core and SSM2603 audio codec.
	  Based on the Zedboard sound card pattern (zed_pl_snd_card.c).

	  To compile this driver as a module, choose M here: the module
	  will be called snd-soc-zybo-snd-card.
```
